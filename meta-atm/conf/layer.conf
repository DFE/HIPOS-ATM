## meta-atm/conf/layer.conf
```bitbake
# We have a conf and classes directory, add to BBPATH
BBPATH .= ":${LAYERDIR}"

# We have a packages directory, add to BBFILES
BBFILES += "${LAYERDIR}/recipes*/*/*.bb ${LAYERDIR}/recipes*/*/*.bbappend ${LAYERDIR}/recipes*/*/*.inc"

BBFILE_COLLECTIONS += "atm"
BBFILE_PATTERN_atm := "^${LAYERDIR}/"
BBFILE_PRIORITY_atm = "12"
```
